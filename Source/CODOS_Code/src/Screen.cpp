#include <Arduino.h>
#include <Adafruit_SSD1306.h>
#include <Screen.h>

#define SCREEN_WIDTH 128 // OLED display width, in pixels
#define SCREEN_HEIGHT 32 // OLED display height, in pixels

Adafruit_SSD1306 display(SCREEN_WIDTH, SCREEN_HEIGHT, &Wire);

#define toChar(i) ('0' + i)

//Created with online webtool from www.riyas.org
const unsigned char PROGMEM Logo0 [] = {
// 'Inicio', 128x32px
0x00, 0x00, 0x00, 0x00, 0x7f, 0xf8, 0x00, 0x00, 0x00, 0x00, 0x00, 0x00, 0x00, 0x00, 0x00, 0x00,
0x00, 0x00, 0x00, 0x07, 0xc0, 0x0f, 0x00, 0x00, 0x00, 0x00, 0x00, 0x00, 0x00, 0x00, 0x00, 0x00,
0x00, 0x00, 0x00, 0x3f, 0xc0, 0x01, 0xe0, 0x00, 0x00, 0x00, 0x00, 0x00, 0x00, 0x00, 0x00, 0x00,
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0x00, 0x00, 0x00, 0x00, 0x00, 0x00, 0x00, 0x00, 0x00, 0x00, 0x00, 0x00, 0x00, 0x00, 0x00, 0x00
};

const unsigned char Logo1 [] PROGMEM = {
	0x00, 0x00, 0x00, 0x06, 0x7f, 0xf8, 0x00, 0x00, 0x00, 0x00, 0x00, 0x00, 0x00, 0x00, 0x00, 0x00, 
	0x00, 0x00, 0x00, 0x1f, 0xc0, 0x0f, 0x00, 0x00, 0x00, 0x00, 0x00, 0x00, 0x00, 0x00, 0x00, 0x00, 
	0x00, 0x00, 0x00, 0xff, 0xc0, 0x01, 0xe0, 0x00, 0xc0, 0x00, 0x00, 0x00, 0x00, 0x00, 0x00, 0x00, 
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	0x00, 0x00, 0x00, 0x00, 0x00, 0x00, 0x00, 0x00, 0x00, 0x00, 0x00, 0x00, 0x00, 0x00, 0x00, 0x00
};

// 'barra', 128x10px
const unsigned char barraBitmap [] PROGMEM = {
	0x00, 0x00, 0x00, 0x00, 0x00, 0x00, 0x08, 0x01, 0x80, 0x00, 0x00, 0x07, 0x00, 0x00, 0x00, 0x00, 
	0x00, 0x00, 0x00, 0x00, 0x00, 0x80, 0x08, 0x01, 0x80, 0x00, 0x00, 0x07, 0x00, 0x00, 0x00, 0x00, 
	0x0f, 0xff, 0xff, 0xff, 0xff, 0xff, 0xff, 0xff, 0xff, 0xff, 0xff, 0xff, 0xff, 0xff, 0xff, 0xf8, 
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	0x00, 0x00, 0x00, 0x00, 0x00, 0x00, 0x08, 0x01, 0x80, 0x00, 0x00, 0x07, 0x00, 0x00, 0x00, 0x00
};

// 'Cara_Bien', 16x16px
const unsigned char Cara_BienBitmap [] PROGMEM = {
	0x07, 0xe0, 0x18, 0x18, 0x20, 0x04, 0x60, 0x06, 0x4e, 0x72, 0x8a, 0x52, 0x8e, 0x71, 0x8e, 0x71, 
	0x80, 0x01, 0x8f, 0xf1, 0x88, 0x12, 0x46, 0x62, 0x21, 0x84, 0x30, 0x0c, 0x0c, 0x30, 0x03, 0xc0
};
// 'Cara_Mal', 16x16px
const unsigned char Cara_MalBitmap [] PROGMEM = {
	0x07, 0xe0, 0x18, 0x18, 0x20, 0x04, 0x60, 0x06, 0x40, 0x02, 0x8e, 0x72, 0x8a, 0x51, 0x8e, 0x71, 
	0x8e, 0x71, 0x80, 0x01, 0x83, 0xc2, 0x44, 0x22, 0x20, 0x04, 0x30, 0x0c, 0x0c, 0x30, 0x03, 0xc0
};
// 'Cara_Meh', 16x16px
const unsigned char Cara_MehBitmap [] PROGMEM = {
	0x07, 0xe0, 0x18, 0x18, 0x20, 0x04, 0x60, 0x06, 0x40, 0x02, 0x8e, 0x72, 0x8a, 0x51, 0x8e, 0x71, 
	0x8e, 0x71, 0x80, 0x01, 0x8f, 0xf2, 0x40, 0x02, 0x20, 0x04, 0x30, 0x0c, 0x0c, 0x30, 0x03, 0xc0
};
// 'Cara_OK', 16x16px
const unsigned char Cara_OkBitmap [] PROGMEM = {
	0x07, 0xe0, 0x18, 0x18, 0x20, 0x04, 0x60, 0x06, 0x4e, 0x72, 0x8a, 0x52, 0x8e, 0x71, 0x8e, 0x71, 
	0x80, 0x01, 0x80, 0x01, 0x88, 0x12, 0x44, 0x22, 0x23, 0xc4, 0x30, 0x0c, 0x0c, 0x30, 0x03, 0xc0
};
// 'Cara_MuyMal', 16x16px
const unsigned char Cara_MuyMal [] PROGMEM = {
	0x07, 0xe0, 0x18, 0x18, 0x20, 0x04, 0x6c, 0x36, 0x42, 0x42, 0x80, 0x02, 0x8c, 0x31, 0x8a, 0x51, 
	0x8e, 0x71, 0x8e, 0x71, 0x80, 0x02, 0x4f, 0xe2, 0x20, 0x04, 0x30, 0x0c, 0x0c, 0x30, 0x03, 0xc0
};

void InitScreen(){
    

    if(!display.begin(SSD1306_SWITCHCAPVCC, 0x3C)) { // Address 0x3C for 128x32
        Serial.println(F("SSD1306 allocation failed"));
        for(;;); 
    }

    display.clearDisplay();
    drawLogo();

}

void drawLogo(){
  for(uint8_t i = 0; i < 5; i++){
    display.clearDisplay();
    display.drawBitmap(0,0, Logo0, SCREEN_WIDTH, SCREEN_HEIGHT, SSD1306_WHITE);
    display.display();
    delay(300);
    display.clearDisplay();
    display.drawBitmap(0,0, Logo1, SCREEN_WIDTH, SCREEN_HEIGHT, SSD1306_WHITE);
    display.display();
    delay(300);
  }
}

void drawInfo(uint16_t pValue){
  static uint16_t lastValue = 0;
  static uint16_t counter = 0;
  uint8_t alreadyNonZero = 0;
  uint8_t currentDigit = 0;
  uint16_t divisor = 1000;
  uint16_t initialValue = pValue;

  // if the value has not change we can avoid updating the display
  if(lastValue != pValue || pValue > 5000){

    lastValue = pValue;

    display.clearDisplay();

    display.setTextSize(2);      // Normal 1:1 pixel scale
    display.setTextColor(SSD1306_WHITE); // Draw white text
    display.setCursor(0, 0);     // Start at top-left corner
    display.cp437(true);         // Use full 256 char 'Code Page 437' font

    /*display.setCursor(0, 0);
    display.write('C');
    display.write('O');
    display.setTextSize(1);      
    display.write('2');
    display.setTextSize(2);     
    display.write(':');*/

    if(pValue < 600){
      display.drawBitmap(0,0, Cara_BienBitmap, 16, 16, SSD1306_WHITE);
    }else if(pValue < 800){
      display.drawBitmap(0,0, Cara_OkBitmap, 16, 16, SSD1306_WHITE);
    }else if(pValue < 1000){
      display.drawBitmap(0,0, Cara_MehBitmap, 16, 16, SSD1306_WHITE);
    }else if(pValue < 1500){
      display.drawBitmap(0,0, Cara_MalBitmap, 16, 16, SSD1306_WHITE);
    }else{
      display.drawBitmap(0,0, Cara_MuyMal, 16, 16, SSD1306_WHITE);
    }
    
    display.setCursor(35, 0);
    display.setTextSize(2); 
    for( int8_t digit = 3; digit >= 0; digit--){
      
      currentDigit = (uint8_t)(pValue/divisor);
      if(alreadyNonZero == 1){
        display.write(toChar(currentDigit));
      }else{
        if(currentDigit == 0){
          display.write(' ');
        }else{
          display.write(toChar(currentDigit));
          alreadyNonZero = 1;
        }
      }
      pValue = pValue - currentDigit*divisor;
      divisor = divisor/10;
    }

    display.setTextSize(1);
    display.setCursor(95, 8);    
    display.write('p');
    display.write('p');
    display.write('m');

    // Draw the fixed scale
    display.drawBitmap(0,20, barraBitmap, SCREEN_WIDTH, 10, SSD1306_WHITE);

    // Fill the rectangle until
    if(initialValue > 2000)
      initialValue = 2000;

    // The scale is from 0 to 2000ppm and measures 120px, so we have to adapt the length
    // to the value.
    display.fillRect(5,23,(int16_t)(initialValue*120.0f/2000.0f),5,SSD1306_WHITE);
    
  }

  display.drawLine(0,31,5,31,SSD1306_BLACK);
  display.drawLine(0,31, counter%5,31,SSD1306_WHITE);

  display.display();

  counter++;
}